## config/boards/arm/cyber60_rev_d/Kconfig.board
```kconfig
# cyber60 board configuration

# Copyright (c) 2022 Stefan Sundin (4pplet)
# SPDX-License-Identifier: MIT

config BOARD_CYBER60_REV_D
	bool "FuuKB"
	depends on SOC_NRF52840_QIAA
```
